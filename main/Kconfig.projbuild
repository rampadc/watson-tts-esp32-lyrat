## main/Kconfig.projbuild
```kconfig
menu "Wi-Fi Configuration"

config WIFI_SSID
    string "WiFi SSID"
	default "guest"
	help
		SSID (network name) for the example to connect to.

config WIFI_PASSWORD
    string "WiFi Password"
    default "train-during-harbor-science"
	help
		WiFi password (WPA or WPA2) for the example to use.

		Can be left blank if the network has no security set.

endmenu

menu "IBM Watson Configuration"

	config TTS_SERVICE_ENDPOINT
		string "Watson Text-to-Speech service endpoint"
		default "https://api.au-syd.text-to-speech.watson.cloud.ibm.com"
		help
			Service endpoint for Watson Text-to-Speech
			https://cloud.ibm.com/apidocs/text-to-speech#service-endpoint
	
	config TTS_AUTHORIZATION_BASE64
		string "Watson Text-to-Speech authorization encoded in base64 prepended with 'Basic '"
		default "Basic XYZ"
		help
			Encode base64 of "apikey:{actual api key}". Put encoded version after 'Basic '.

			For example, if the APIKey provided is "rockon". Then the combined username and 
			apikey for basic auth is "apikey:rockon". Encoding this in base64 gives "YXBpa2V5OnJvY2tvbg==".

			Fill this field with "Basic YXBpa2V5OnJvY2tvbg=="

	config TTS_VOICE
		string "Watson Text-to-Speech Voice"
		default "en-GB_KateV3Voice"
		help
			Voice ID for Watson Text-to-Speech
			https://cloud.ibm.com/apidocs/text-to-speech#list-voices
endmenu
```
